## examples/lvgldemo/Kconfig
```kconfig
#
# For a description of the syntax of this configuration file,
# see the file kconfig-language.txt in the NuttX tools repository.
#

menuconfig EXAMPLES_LVGLDEMO
	tristate "LVGL Demo"
	default n
	depends on GRAPHICS_LVGL
	---help---
		Enable build the Light and Versatile Graphics Library Demo programs

if EXAMPLES_LVGLDEMO

config EXAMPLES_LVGLDEMO_PRIORITY
	int "lvgldemo task priority"
	default 100

config EXAMPLES_LVGLDEMO_STACKSIZE
	int "lvgldemo stack size"
	default 16384

config EXAMPLES_LVGLDEMO_INPUT_DEVPATH
	string "Touchscreen device path"
	default "/dev/input0"
	depends on INPUT_TOUCHSCREEN
	---help---
		The path to the touchscreen device. Default: "/dev/input0"

config EXAMPLES_LVGLDEMO_KEYBOARD_DEVPATH
	string "Keyboard device path"
	default "/dev/kbd0"
	depends on INPUT_KEYBOARD
	---help---
		The path to the NuttX keyboard device. Default: "/dev/kbd0"

config EXAMPLES_LVGLDEMO_MOUSE_DEVPATH
	string "Mouse device path"
	default "/dev/mouse0"
	depends on INPUT_MOUSE
	---help---
		The path to the NuttX mouse device. Default: "/dev/mouse0"

config EXAMPLES_LVGLDEMO_MOUSE_WHEEL_STEP
	int "Mouse wheel scroll step"
	default 12
	range 1 64
	depends on INPUT_MOUSE_WHEEL
	---help---
		Vertical scroll pixels per mouse wheel report delta.

endif # EXAMPLES_LVGLDEMO
```

## interpreters/berry/Kconfig
```kconfig
#
# For a description of the syntax of this configuration file,
# see the file kconfig-language.txt in the NuttX tools repository.
#

config INTERPRETERS_BERRY
	tristate "Berry scripting language"
	default n
	depends on ARCH_SETJMP_H
	depends on LIBC_FLOATINGPOINT
	depends on SYSTEM_SYSTEM
	---help---
		Enable the Berry embedded scripting language as an NSH built-in
		command.  Berry provides a small ANSI C99 compiler, register-based
		virtual machine, garbage collector, file I/O, bytecode loading and
		saving, and built-in modules.

		The default NuttX configuration keeps Berry shared-library loading
		disabled so boards do not need CONFIG_LIBC_DLFCN.  The math module
		is enabled, so select a NuttX math library or provide one from the
		toolchain.

if INTERPRETERS_BERRY

config INTERPRETERS_BERRY_PROGNAME
	string "Berry program name"
	default "berry"
	---help---
		The command name used to start the Berry interpreter.

config INTERPRETERS_BERRY_PRIORITY
	int "Berry interpreter priority"
	default 100
	---help---
		Task priority of the Berry interpreter main task.

config INTERPRETERS_BERRY_STACKSIZE
	int "Berry interpreter stack size"
	default 12288
	---help---
		Size of the stack allocated for the Berry interpreter main task.

config INTERPRETERS_BERRY_LVGL
	bool "Berry LVGL bindings"
	default n
	depends on GRAPHICS_LVGL
	depends on LV_USE_NUTTX
	---help---
		Enable a small native Berry module named lv that drives LVGL
		through the NuttX LVGL framebuffer backend.  This is intended
		for boards that already expose a working framebuffer such as
		/dev/fb0.

config INTERPRETERS_BERRY_LVGL_GLOBAL
	bool "Preload Berry LVGL module as global lv"
	default y
	depends on INTERPRETERS_BERRY_LVGL
	---help---
		Load the lv module into the Berry global namespace when the
		interpreter starts.  Scripts can still use import lv explicitly.

config INTERPRETERS_BERRY_LVGL_MOUSE
	bool "Berry LVGL mouse input"
	default y if INPUT_MOUSE
	depends on INTERPRETERS_BERRY_LVGL
	depends on INPUT_MOUSE
	---help---
		Add a simple LVGL pointer input device backed by a NuttX mouse
		character device.

config INTERPRETERS_BERRY_LVGL_MOUSE_DEVPATH
	string "Berry LVGL mouse device path"
	default "/dev/mouse0"
	depends on INTERPRETERS_BERRY_LVGL_MOUSE
	---help---
		Mouse device used by the Berry LVGL pointer input adapter.

endif # INTERPRETERS_BERRY
```
